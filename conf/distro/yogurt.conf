## conf/distro/yogurt.conf
```bitbake
require conf/distro/poky.conf
require common.inc

DISTRO = "yogurt"
DISTRO_NAME = "Yogurt (Phytec Base Distribution)"

DISTRO_FEATURES += "systemd"
# *** Changed by GMK **************************
#DISTRO_FEATURES_remove = "argp irda pcmcia zeroconf x11 ptest multiarch vulkan"
DISTRO_FEATURES_remove = "argp irda pcmcia zeroconf ptest multiarch vulkan wayland"
# *** End Changed by GMK **********************
DISTRO_FEATURES_remove_mx6ul = "opengl wayland"
```
